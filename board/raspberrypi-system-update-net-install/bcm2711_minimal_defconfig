## configs/raspberrypi-system-update-net-install_defconfig
```kconfig
BR2_arm=y
BR2_cortex_a72=y
BR2_ARM_FPU_VFPV4=y
BR2_TOOLCHAIN_BUILDROOT_GLIBC=y
BR2_PACKAGE_HOST_LINUX_HEADERS_CUSTOM_5_15=y
BR2_TOOLCHAIN_BUILDROOT_CXX=y
BR2_CCACHE=y
BR2_TARGET_GENERIC_HOSTNAME="raspberry"
BR2_TARGET_GENERIC_ISSUE="Raspberry Pi - system update init"
BR2_INIT_SYSTEMD=y
# BR2_TARGET_ENABLE_ROOT_LOGIN is not set
BR2_SYSTEM_BIN_SH_BASH=y
BR2_SYSTEM_DHCP="eth0"
BR2_SYSTEM_DEFAULT_PATH="/bin:/sbin:/usr/bin:/usr/sbin"
BR2_ROOTFS_USERS_TABLES="board/raspberrypi-system-update-net-install/users"
BR2_ROOTFS_OVERLAY="board/raspberrypi-system-update-net-install/rootfs-overlay"
BR2_ROOTFS_POST_BUILD_SCRIPT="board/raspberrypi-system-update-net-install/post-build.sh"
BR2_ROOTFS_POST_IMAGE_SCRIPT="board/raspberrypi-system-update-net-install/post-image.sh"
BR2_LINUX_KERNEL=y
BR2_LINUX_KERNEL_CUSTOM_GIT=y
BR2_LINUX_KERNEL_CUSTOM_REPO_URL="https://github.com/raspberrypi/linux"
BR2_LINUX_KERNEL_CUSTOM_REPO_VERSION="rpi-5.15.y"
BR2_LINUX_KERNEL_USE_CUSTOM_CONFIG=y
BR2_LINUX_KERNEL_CUSTOM_CONFIG_FILE="board/raspberrypi-system-update-net-install/bcm2711_minimal_defconfig"
BR2_LINUX_KERNEL_DTS_SUPPORT=y
BR2_LINUX_KERNEL_INTREE_DTS_NAME="bcm2711-rpi-cm4 bcm2711-rpi-cm4s bcm2711-rpi-4-b bcm2711-rpi-400"
BR2_LINUX_KERNEL_NEEDS_HOST_OPENSSL=y
BR2_PACKAGE_XZ=y
BR2_PACKAGE_DOSFSTOOLS=y
BR2_PACKAGE_DOSFSTOOLS_FSCK_FAT=y
BR2_PACKAGE_DOSFSTOOLS_MKFS_FAT=y
BR2_PACKAGE_E2FSPROGS=y
BR2_PACKAGE_E2FSPROGS_DEBUGFS=y
BR2_PACKAGE_MMC_UTILS=y
BR2_PACKAGE_RPI_FIRMWARE=y
BR2_PACKAGE_RPI_FIRMWARE_VARIANT_PI4_CD=y
BR2_PACKAGE_RPI_FIRMWARE_CONFIG_FILE="board/raspberrypi-system-update-net-install/config_cm4io.txt"
BR2_PACKAGE_RPI_FIRMWARE_CMDLINE_FILE="board/raspberrypi-system-update-net-install/cmdline_cm4io.txt"
BR2_PACKAGE_DTBOCFG=y
BR2_PACKAGE_GVFS=y
BR2_PACKAGE_I2C_TOOLS=y
BR2_PACKAGE_LVM2=y
BR2_PACKAGE_PCIUTILS=y
BR2_PACKAGE_RASPI_GPIO=y
BR2_PACKAGE_UHUBCTL=y
BR2_PACKAGE_CA_CERTIFICATES=y
BR2_PACKAGE_OPENSSL=y
BR2_PACKAGE_SQLITE=y
BR2_PACKAGE_DTC=y
BR2_PACKAGE_DTC_PROGRAMS=y
BR2_PACKAGE_LIBNL=y
BR2_PACKAGE_NEWT=y
BR2_PACKAGE_IFUPDOWN=y
BR2_PACKAGE_IPROUTE2=y
BR2_PACKAGE_IPUTILS=y
# BR2_PACKAGE_IPUTILS_ARPING is not set
# BR2_PACKAGE_IPUTILS_CLOCKDIFF is not set
# BR2_PACKAGE_IPUTILS_RDISC is not set
# BR2_PACKAGE_IPUTILS_TRACEPATH is not set
# BR2_PACKAGE_IPUTILS_NINFOD is not set
BR2_PACKAGE_SUDO=y
BR2_PACKAGE_RPI_EEPROM=y
BR2_PACKAGE_RPI_EEPROM_PRIVATE_KEY="../private.pem"
BR2_PACKAGE_RPI_EEPROM_ADMIN_SSH_LOGIN="../authorized_keys"
BR2_PACKAGE_RPI_SYSTEM_UPDATE=y
BR2_PACKAGE_RPI_SYSTEM_UPDATE_PUBLIC_KEY="../public.pem"
BR2_PACKAGE_RPI_SYSTEM_UPDATE_URL="https://update.raspberrypi.com/rpi-system-update-example/version"
BR2_PACKAGE_RPI_SYSTEM_UPDATE_AUTO_INSTALL=y
BR2_PACKAGE_UTIL_LINUX_BINARIES=y
BR2_PACKAGE_UTIL_LINUX_MOUNTPOINT=y
BR2_PACKAGE_UTIL_LINUX_PIVOT_ROOT=y
BR2_PACKAGE_UTIL_LINUX_WIPEFS=y
BR2_TARGET_ROOTFS_CPIO=y
BR2_TARGET_ROOTFS_CPIO_ZSTD=y
# BR2_TARGET_ROOTFS_TAR is not set
BR2_PACKAGE_HOST_DOSFSTOOLS=y
BR2_PACKAGE_HOST_E2FSPROGS=y
BR2_PACKAGE_HOST_GENIMAGE=y
BR2_PACKAGE_HOST_KMOD_GZ=y
BR2_PACKAGE_HOST_KMOD_ZSTD=y
BR2_PACKAGE_HOST_KMOD_XZ=y
BR2_PACKAGE_HOST_MTOOLS=y
BR2_PACKAGE_HOST_RPI_EEPROM=y
```

## configs/raspberrypi-system-update_defconfig
```kconfig
BR2_aarch64=y
BR2_cortex_a72=y
BR2_ARM_FPU_VFPV4=y
BR2_TOOLCHAIN_BUILDROOT_CXX=y
BR2_CCACHE=y
BR2_TARGET_GENERIC_HOSTNAME="raspberry"
BR2_TARGET_GENERIC_ISSUE="Raspberry Pi"
BR2_INIT_SYSTEMD=y
# BR2_TARGET_ENABLE_ROOT_LOGIN is not set
BR2_SYSTEM_BIN_SH_BASH=y
BR2_SYSTEM_DHCP="end0"
BR2_SYSTEM_DEFAULT_PATH="/bin:/sbin:/usr/bin:/usr/sbin"
BR2_ROOTFS_USERS_TABLES="board/raspberrypi-system-update/users"
BR2_ROOTFS_OVERLAY="board/raspberrypi-system-update/rootfs-overlay"
BR2_ROOTFS_POST_BUILD_SCRIPT="board/raspberrypi-system-update/post-build.sh"
BR2_ROOTFS_POST_IMAGE_SCRIPT="board/raspberrypi-system-update/post-image.sh"
BR2_LINUX_KERNEL=y
BR2_LINUX_KERNEL_CUSTOM_GIT=y
BR2_LINUX_KERNEL_CUSTOM_REPO_URL="https://github.com/raspberrypi/linux"
BR2_LINUX_KERNEL_CUSTOM_REPO_VERSION="rpi-6.6.y"
BR2_LINUX_KERNEL_USE_CUSTOM_CONFIG=y
BR2_LINUX_KERNEL_CUSTOM_CONFIG_FILE="board/raspberrypi-system-update/bcm2711_raspberrypi_system_update_defconfig"
BR2_LINUX_KERNEL_DTS_SUPPORT=y
BR2_LINUX_KERNEL_INTREE_DTS_NAME="broadcom/bcm2711-rpi-cm4 broadcom/bcm2711-rpi-cm4s broadcom/bcm2711-rpi-4-b broadcom/bcm2711-rpi-400 broadcom/bcm2712-rpi-5-b broadcom/bcm2712-rpi-cm5-cm5io broadcom/bcm2712-rpi-cm5-cm4io"
BR2_LINUX_KERNEL_NEEDS_HOST_OPENSSL=y
BR2_PACKAGE_BUSYBOX_INDIVIDUAL_BINARIES=y
BR2_PACKAGE_XZ=y
BR2_PACKAGE_DOSFSTOOLS=y
BR2_PACKAGE_DOSFSTOOLS_FATLABEL=y
BR2_PACKAGE_DOSFSTOOLS_FSCK_FAT=y
BR2_PACKAGE_DOSFSTOOLS_MKFS_FAT=y
BR2_PACKAGE_E2FSPROGS=y
BR2_PACKAGE_E2FSPROGS_DEBUGFS=y
BR2_PACKAGE_MMC_UTILS=y
BR2_PACKAGE_BRCMFMAC_SDIO_FIRMWARE_RPI=y
BR2_PACKAGE_BRCMFMAC_SDIO_FIRMWARE_RPI_BT=y
BR2_PACKAGE_BRCMFMAC_SDIO_FIRMWARE_RPI_WIFI=y
BR2_PACKAGE_RPI_FIRMWARE=y
BR2_PACKAGE_RPI_FIRMWARE_VARIANT_PI4=y
BR2_PACKAGE_RPI_FIRMWARE_CONFIG_FILE="board/raspberrypi-system-update/config-rpi-system-update.txt"
BR2_PACKAGE_RPI_FIRMWARE_CMDLINE_FILE="board/raspberrypi-system-update/cmdline-rpi-system-update.txt"
BR2_PACKAGE_DTBOCFG=y
BR2_PACKAGE_LUKSMETA=y
BR2_PACKAGE_PARTED=y
BR2_PACKAGE_PCIUTILS=y
BR2_PACKAGE_RASPI_GPIO=y
BR2_PACKAGE_RPI_USERLAND=y
BR2_PACKAGE_UHUBCTL=y
BR2_PACKAGE_CA_CERTIFICATES=y
BR2_PACKAGE_DTC=y
BR2_PACKAGE_DTC_PROGRAMS=y
BR2_PACKAGE_LIBCGROUP=y
BR2_PACKAGE_LIBCGROUP_TOOLS=y
BR2_PACKAGE_NEWT=y
BR2_PACKAGE_BLUEZ5_UTILS=y
BR2_PACKAGE_BLUEZ5_UTILS_CLIENT=y
BR2_PACKAGE_BLUEZ5_UTILS_MONITOR=y
BR2_PACKAGE_BLUEZ5_UTILS_PLUGINS_HID=y
BR2_PACKAGE_IPROUTE2=y
BR2_PACKAGE_NETWORK_MANAGER=y
BR2_PACKAGE_NETWORK_MANAGER_CLI=y
BR2_PACKAGE_NTP=y
BR2_PACKAGE_NTP_NTPDATE=y
BR2_PACKAGE_NTP_NTPTIME=y
BR2_PACKAGE_OPENSSH=y
BR2_PACKAGE_TINYSSH=y
BR2_PACKAGE_WGET=y
BR2_PACKAGE_WIRELESS_REGDB=y
BR2_PACKAGE_WIRELESS_TOOLS=y
BR2_PACKAGE_WIRELESS_TOOLS_LIB=y
BR2_PACKAGE_WPA_SUPPLICANT=y
BR2_PACKAGE_WPA_SUPPLICANT_AP_SUPPORT=y
BR2_PACKAGE_WPA_SUPPLICANT_WPA3=y
BR2_PACKAGE_WPA_SUPPLICANT_CLI=y
BR2_PACKAGE_WPA_SUPPLICANT_PASSPHRASE=y
BR2_PACKAGE_DASH=y
BR2_PACKAGE_FILE=y
BR2_PACKAGE_SUDO=y
BR2_PACKAGE_DOCKER_CLI=y
BR2_PACKAGE_DOCKER_COMPOSE=y
BR2_PACKAGE_DOCKER_ENGINE=y
BR2_PACKAGE_DOCKER_ENGINE_DRIVER_DEVICEMAPPER=y
BR2_PACKAGE_RPI_EEPROM=y
BR2_PACKAGE_RPI_EEPROM_PRIVATE_KEY="../private.pem"
BR2_PACKAGE_RPI_EEPROM_ADMIN_SSH_LOGIN="../authorized_keys"
BR2_PACKAGE_RPI_SYSTEM_UPDATE=y
BR2_PACKAGE_RPI_SYSTEM_UPDATE_VERSION=1
BR2_PACKAGE_RPI_SYSTEM_UPDATE_PUBLIC_KEY="../public.pem"
BR2_PACKAGE_RPI_SYSTEM_UPDATE_URL="https://update.raspberrypi.com/rpi-system-update-example/version"
BR2_PACKAGE_RPI_SYSTEM_UPDATE_MONITOR=y
BR2_PACKAGE_RPI_SYSTEM_UPDATE_ENCRYPT_APPLICATION_FS=y
BR2_PACKAGE_RPI_SYSTEM_UPDATE_DOCKER_APPLICATION=y
BR2_PACKAGE_RPI_SYSTEM_UPDATE_DOCKER_SERVICE_NAME="home-assistant"
BR2_PACKAGE_SYSTEMD_ANALYZE=y
BR2_PACKAGE_UTIL_LINUX_WIPEFS=y
BR2_TARGET_ROOTFS_CPIO=y
BR2_TARGET_ROOTFS_CPIO_ZSTD=y
# BR2_TARGET_ROOTFS_TAR is not set
BR2_PACKAGE_HOST_DOSFSTOOLS=y
BR2_PACKAGE_HOST_E2FSPROGS=y
BR2_PACKAGE_HOST_GENIMAGE=y
BR2_PACKAGE_HOST_KMOD_GZ=y
BR2_PACKAGE_HOST_KMOD_ZSTD=y
BR2_PACKAGE_HOST_KMOD_XZ=y
BR2_PACKAGE_HOST_MTOOLS=y
BR2_PACKAGE_HOST_RPI_EEPROM=y
```

## package/rpi-eeprom/Config.in
```kconfig
config BR2_PACKAGE_RPI_EEPROM
	bool "rpi-eeprom"
	select BR2_PACKAGE_LIBOPENSSL_BIN
	select BR2_PACKAGE_PYTHON3
	select BR2_PACKAGE_PYTHON_PYCRYPTODOMEX
	help
	  Raspberry Pi bootloader tools.

	  https://github.com/raspberrypi/rpi-eeprom
```

## package/rpi-eeprom/Config.in.host
```kconfig
config BR2_PACKAGE_HOST_RPI_EEPROM
	bool "host rpi-eeprom"
	select BR2_PACKAGE_LIBOPENSSL_BIN
	select BR2_PACKAGE_PYTHON3
	select BR2_PACKAGE_PYTHON_PYCRYPTODOMEX
	help
	  Raspberry Pi bootloader tools.

	  https://github.com/raspberrypi/rpi-eeprom
```

## package/rpi-system-update/Config.in
```kconfig
config BR2_PACKAGE_RPI_SYSTEM_UPDATE
	bool "rpi-system-update"
	select BR2_PACKAGE_RASPBERRYPI_SECURE_BOOT
	select BR2_PACKAGE_LIBCURL
	select BR2_PACKAGE_LIBCURL_CURL

	help
	   Tools for updating the system software in boot.img / tryboot.img

config BR2_PACKAGE_RPI_SYSTEM_UPDATE_VERSION
	int "Version number"
	default 0
	depends on BR2_PACKAGE_RPI_SYSTEM_UPDATE

	help
	   This version number is stored within the boot.img system software and
	   is compared against the number reported by the upgrade server. If
	   the upgrade version is higher then the new image is downloaded and
	   boot.img is upgraded.

config BR2_PACKAGE_RPI_SYSTEM_UPDATE_PUBLIC_KEY
	string "Public key"
	default ""
	depends on BR2_PACKAGE_RPI_SYSTEM_UPDATE

	help
	    The filenmame of the RSA public key in PEM format to include in the
	    image so that rpi-system-update can verify the signature of the
	    downloaded boot.img file against boot.sig.

config BR2_PACKAGE_RPI_SYSTEM_UPDATE_URL
	string "URL for system update version information"
	default ""
	depends on BR2_PACKAGE_RPI_SYSTEM_UPDATE

	help
      The URL of the version file that the OS should check for new updates.

config BR2_PACKAGE_RPI_SYSTEM_UPDATE_BOOT_DEVICE
	string "Boot device"
	default "/dev/mmcblk0"
	depends on BR2_PACKAGE_RPI_SYSTEM_UPDATE

	help
	    The local block device used for the boot and application file-systems.
config BR2_PACKAGE_RPI_SYSTEM_UPDATE_BOOT_DEVICE

config BR2_PACKAGE_RPI_SYSTEM_UPDATE_MONITOR
	bool "Update monitor"
	default N
	depends on BR2_PACKAGE_RPI_SYSTEM_UPDATE

	help
	    Installs a systemd timer service that periodically polls the
	    update server for new software releases. If a new release is detected
	    it is installed automatically and will be installed when the system
	    is rebooted.

config BR2_PACKAGE_RPI_SYSTEM_UPDATE_ENCRYPT_APPLICATION_FS
	bool "Encrypt FS"
	default N
	depends on BR2_PACKAGE_RPI_SYSTEM_UPDATE
	depends on BR2_PACKAGE_CRYPTSETUP
	help
	    Use LUKS to encrypt the application file-system. This requires that the
	    the OTP private key has already been written.

config BR2_PACKAGE_RPI_SYSTEM_UPDATE_DOCKER_APPLICATION
	bool "Docker setup"
	default N
	depends on BR2_PACKAGE_RPI_SYSTEM_UPDATE
	depends on BR2_PACKAGE_DOCKER_COMPOSE

	help
	   Installs the docker-compose file and ensures that the application
	   partition is mounted before docker is started.

config BR2_PACKAGE_RPI_SYSTEM_UPDATE_DOCKER_SERVICE_NAME
	string "Service name"
	default ""
	depends on BR2_PACKAGE_RPI_SYSTEM_UPDATE_DOCKER_APPLICATION

	help
	   The name of the docker-compose service to start.

config BR2_PACKAGE_RPI_SYSTEM_UPDATE_AUTO_INSTALL
	bool "Network auto install"
	default N
	depends on BR2_PACKAGE_RPI_SYSTEM_UPDATE

	help
	    Use the rpi-system-update tool to provision (or install) the OS from
	     scratch.   Typically, this would be used to create an automated
	     network install image that is launched by the Raspberry Pi EEPROM
	     bootloader to install a new system e.g. when a custom GPIO reset
	     button is pressed during boot.


config BR2_PACKAGE_RPI_SYSTEM_UPDATE_AUTO_INSTALL_BOOT_PARTITION_MB
	int "Boot partition size in megabytes"
	default 512
	depends on BR2_PACKAGE_RPI_SYSTEM_UPDATE_AUTO_INSTALL

	help
	    The desired size for the boot partition (FAT32) in megabytes.
```
